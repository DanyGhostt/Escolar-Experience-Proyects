// ==============================================================================
// Practica 05: Metronomo Digital con Buzzer y Pantalla OLED
// Practice 05: Digital Metronome with Buzzer and OLED Display
//
// Descripcion / Description:
// [ES] Metronomo digital con control de tempo (BPM: 30 a 240) mediante pulsadores
//      e interrupciones de hardware, retroalimentacion sonora con buzzer y animacion
//      grafica de 4 tiempos en pantalla OLED SSD1306.
// [EN] Digital metronome with tempo control (BPM: 30 to 240) via push buttons and
//      hardware interrupts, acoustic feedback via buzzer, and 4-beat visual animation
//      on SSD1306 OLED display.
//
// ==============================================================================

#include <Adafruit_GFX.h>
#include <Adafruit_SSD1306.h>

// ------------------------------------------------------------------------------
// Configuracion de Pantalla OLED / OLED Display Configuration
// ------------------------------------------------------------------------------
#define SCREEN_WIDTH 128
#define SCREEN_HEIGHT 64
#define OLED_RESET    -1  // No se usa pin reset / No reset pin used
Adafruit_SSD1306 display(SCREEN_WIDTH, SCREEN_HEIGHT, &Wire, OLED_RESET);
#include <Fonts/FreeMono12pt7b.h>
#include <Fonts/FreeMono24pt7b.h>
#include <Fonts/FreeSans12pt7b.h>
#include <Fonts/FreeSans24pt7b.h>
#include <Fonts/FreeSansBold12pt7b.h >
#include <Fonts/FreeSansBold24pt7b.h >
#include <Fonts/FreeSerif12pt7b.h>
#include <Fonts/FreeSerif24pt7b.h>
const unsigned char PROGMEM LogoITS [] = {
  0xff, 0xff, 0xff, 0xff, 0xff, 0xff, 0xff, 0xff, 0xff, 0xff, 0xff, 0xff, 0xff, 0xff, 0xff, 0xff,
  0xff, 0xff, 0xff, 0xff, 0xff, 0xff, 0xff, 0xc0, 0x07, 0xff, 0xff, 0xff, 0xff, 0xff, 0xff, 0xff,
  0xff, 0xff, 0xff, 0xff, 0xff, 0xff, 0xf8, 0x00, 0x00, 0x7f, 0xff, 0xff, 0xff, 0xff, 0xff, 0xff,
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  0xff, 0xff, 0x08, 0x00, 0x00, 0x00, 0x00, 0x00, 0x00, 0x01, 0xff, 0xff, 0xff, 0xff, 0xff, 0xff
};
const unsigned char Tec_ITS [] PROGMEM = {
 0xff, 0xff, 0xff, 0xff, 0xff, 0xff, 0xcf, 0xff, 0xff, 0xff, 0xff, 0xff, 0xff, 0xff, 0xff, 0xff, 
 0xff, 0xff, 0xff, 0xff, 0xff, 0xff, 0xb7, 0xf0, 0x00, 0x07, 0xe1, 0xff, 0xff, 0xff, 0xff, 0xff, 
  0xff, 0xff, 0xff, 0xff, 0xff, 0xff, 0xbb, 0xc0, 0xff, 0x83, 0xce, 0xff, 0xff, 0xff, 0xff, 0xff, 
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  0xff, 0xff, 0xff, 0xff, 0xff, 0xff, 0xff, 0xff, 0xff, 0xff, 0xff, 0xff, 0xff, 0xff, 0xff, 0xff
};


const unsigned char PROGMEM LOGO[] = {
 0x00, 0x00, 0x00, 0x00, 0x00, 0x00, 0x08, 0x00, 0x00, 0x00, 0x00, 0x00, 0x00, 0x00, 0x00, 0x00,
0x00, 0x00, 0x00, 0x00, 0x00, 0x00, 0x36, 0x00, 0x10, 0x00, 0x00, 0x00, 0x00, 0x00, 0x00, 0x00,
0x00, 0x00, 0x00, 0x00, 0x00, 0x00, 0x1F, 0x00, 0x0C, 0x02, 0x00, 0x00, 0x00, 0x00, 0x00, 0x00,
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0x00, 0x00, 0x00, 0x00, 0x00, 0x00, 0x18, 0x00, 0x1C, 0x00, 0x00, 0x00, 0x00, 0x00, 0x00, 0x00

};
// Pines de botones
const int botonIncremento = 4;
const int botonDecremento = 15;
const int botonArranque = 14;
const int botonParo = 12;

// ------------------------------------------------------------------------------
// Definicion de Pines y Variables / Pin Definitions & Metronome Variables
// ------------------------------------------------------------------------------
// Pines de botones de control / Control Push Buttons
const int botonIncremento = 4;  // [ES] Aumentar BPM  / [EN] Increase BPM (GPIO 4)
const int botonDecremento = 15; // [ES] Disminuir BPM / [EN] Decrease BPM (GPIO 15)
const int botonArranque = 14;   // [ES] Iniciar       / [EN] Start Metronome (GPIO 14)
const int botonParo = 12;       // [ES] Detener       / [EN] Stop Metronome (GPIO 12)

// Pin para la bocina o buzzer / Buzzer output pin
const int pinBocina = 27;

// Variables de control de tempo / Tempo control variables
volatile int bpm = 60;          // [ES] BPM inicial           / [EN] Initial BPM
volatile bool activo = false;   // [ES] Estado metronomo      / [EN] Metronome run state
unsigned long ultimaNota = 0;   // [ES] Temporizador de notas / [EN] Beat timestamp tracker
int rectanguloActivo = -1;      // [ES] Indice de compas (0-3)/ [EN] Active beat box (0-3)
volatile int cambioBPM = 0;     // [ES] Indicador de cambio   / [EN] BPM change flag (1 / -1)

// Banderas de interrupcion para botones / Button interrupt flags
volatile bool botonIncrementoPresionado = false;
volatile bool botonDecrementoPresionado = false;
volatile bool botonArranquePresionado = false;
volatile bool botonParoPresionado = false;

// Variables para debouncing / Debounce timing variables
unsigned long ultimoIncremento = 0;
unsigned long ultimoDecremento = 0;
const unsigned long debounceDelay = 200; // 200 ms debounce filter

// ------------------------------------------------------------------------------
// Configuracion Inicial / System Setup
// ------------------------------------------------------------------------------
void setup() {
  display.begin(SSD1306_SWITCHCAPVCC, 0x3C); 
  display.display(); 
  delay(2000); 
  display.clearDisplay();
  display.display();
  delay(1000);

  // Pantallas de presentacion institucional / Splash screens
  display.drawBitmap(0, 0, LogoITS, 128, 64, 1);
  display.display();
  delay(1000);
  display.clearDisplay();
  display.display();
  delay(1000);

  display.drawBitmap(0, 0, Tec_ITS, 128, 64, WHITE);
  display.display();
  delay(1000);
  display.clearDisplay();

display.drawBitmap(0, 0, LOGO, 128, 64, 1);
  display.display();
  delay(1000);
  display.clearDisplay();
  display.display();
  delay(1000);

  delay(2000);
  display.clearDisplay(); // Portada / Cover info
  display.setTextSize(1);
  display.setTextColor(WHITE);
  display.setCursor(0, 10);
  display.println("MICROCONTROLADORES");
display.println("P5-Metronomo Digital");
display.display(); 
  delay(2000);
  display.clearDisplay();  
  
  Serial.begin(9600);

  // Inicializar pantalla OLED / Initialize OLED display
  if (!display.begin(SSD1306_SWITCHCAPVCC, 0x3C)) {
    Serial.println(F("Error al inicializar la pantalla OLED / OLED init failed"));
    while (true);
  }
  display.clearDisplay();
  mostrarPantalla();

  // Configurar pines de botones y bocina / Configure pins
  pinMode(botonIncremento, INPUT_PULLUP);
  pinMode(botonDecremento, INPUT_PULLUP);
  pinMode(botonArranque, INPUT_PULLUP);
  pinMode(botonParo, INPUT_PULLUP);
  pinMode(pinBocina, OUTPUT);

  // Configurar interrupciones por flanco de bajada / Attach falling edge interrupts
  attachInterrupt(digitalPinToInterrupt(botonIncremento), registrarIncremento, FALLING);
  attachInterrupt(digitalPinToInterrupt(botonDecremento), registrarDecremento, FALLING);
  attachInterrupt(digitalPinToInterrupt(botonArranque), registrarArranque, FALLING);
  attachInterrupt(digitalPinToInterrupt(botonParo), registrarParo, FALLING);
}

// ------------------------------------------------------------------------------
// Bucle Principal / Main Loop
// ------------------------------------------------------------------------------
void loop() {
  // Procesar boton de incremento / Process increase BPM button
  if (botonIncrementoPresionado) {
    if (millis() - ultimoIncremento >= debounceDelay) {
      if (bpm < 240) { // Limite superior / Max BPM
        bpm++;
        cambioBPM = 1;
        mostrarPantalla();
      }
      ultimoIncremento = millis();
    }
    botonIncrementoPresionado = false;
  }

  // Procesar boton de decremento / Process decrease BPM button
  if (botonDecrementoPresionado) {
    if (millis() - ultimoDecremento >= debounceDelay) {
      if (bpm > 30) { // Limite inferior / Min BPM
        bpm--;
        cambioBPM = -1;
        mostrarPantalla();
      }
      ultimoDecremento = millis();
    }
    botonDecrementoPresionado = false;
  }

  // Procesar boton de arranque / Process Start button
  if (botonArranquePresionado) {
    activo = true;
    rectanguloActivo = 0;
    mostrarPantalla();
    botonArranquePresionado = false;
  }

  // Procesar boton de paro / Process Stop button
  if (botonParoPresionado) {
    activo = false;
    rectanguloActivo = -1;
    mostrarPantalla();
    botonParoPresionado = false;
  }

  // Generacion periodica de pulsos / Periodic beat generation
  if (activo) {
    unsigned long tiempoActual = millis();
    int intervalo = 60000 / bpm; // Intervalo en ms para el BPM actual / Interval in ms

    if (tiempoActual - ultimaNota >= intervalo) {
      tonoBocina();                                  // Emitir sonido / Beep
      rectanguloActivo = (rectanguloActivo + 1) % 4; // Ciclar compas 1-4 / Cycle beat 1-4
      mostrarPantalla();
      ultimaNota = tiempoActual;
    }
  }
}

// ------------------------------------------------------------------------------
// Renderizado Grafico del Metronomo / Graphical Metronome Rendering
// ------------------------------------------------------------------------------
void mostrarPantalla() {
  display.clearDisplay();

  // [ES] Dibujar 4 bloques de compas / [EN] Draw 4 beat measure boxes
  for (int i = 0; i < 4; i++) {
    display.drawRect(5 + i * 30, 10, 25, 40, WHITE);
    if (i == rectanguloActivo) {
      display.fillRect(5 + i * 30, 10, 25, 40, WHITE); // Rellenar compas activo / Fill active beat
    }
  }

  // [ES] Mostrar valor de BPM / [EN] Display BPM value
  display.setTextSize(1);
  display.setTextColor(WHITE);
  display.setCursor(50, 52);
  display.print("BPM: ");
  display.print(bpm);

  // [ES] Indicadores visuales de ajuste +/- / [EN] Visual +/- adjustment indicators
  display.setCursor(110, 55);
  display.print("+");
  if (cambioBPM == 1) {
    display.drawCircle(115, 57, 5, WHITE);
    cambioBPM = 0;
  }

  display.setCursor(5, 55);
  display.print("-");
  if (cambioBPM == -1) {
    display.drawCircle(10, 57, 5, WHITE);
    cambioBPM = 0;
  }

  display.display();
}

// ------------------------------------------------------------------------------
// Generacion de Pulso Acustico / Acoustic Tone Generation
// ------------------------------------------------------------------------------
void tonoBocina() {
  digitalWrite(pinBocina, HIGH);
  delay(10); // Duracion del pulso en ms / Pulse width in ms
  digitalWrite(pinBocina, LOW);
}

// ------------------------------------------------------------------------------
// Rutinas de Servicio de Interrupcion (ISR) / Interrupt Service Routines
// ------------------------------------------------------------------------------
void registrarIncremento() {
  botonIncrementoPresionado = true;
}

void registrarDecremento() {
  botonDecrementoPresionado = true;
}

void registrarArranque() {
  botonArranquePresionado = true;
}

void registrarParo() {
  botonParoPresionado = true;
}
