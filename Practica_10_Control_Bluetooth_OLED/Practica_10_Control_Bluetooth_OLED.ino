// ==============================================================================
// Practica 10: Control Inalambrico de LEDs por Bluetooth con OLED
// Practice 10: Wireless Bluetooth LED Controller with OLED Display
//
// Descripcion / Description:
// [ES] Control bidireccional e inalambrico de 4 canales de LEDs mediante comunicacion
//      Bluetooth Serial clasica en ESP32, comandos ASCII y monitoreo grafico de
//      estado en pantalla OLED SSD1306.
// [EN] Wireless 4-channel LED controller via classic Bluetooth Serial on ESP32,
//      decoding single-character ASCII commands with real-time status rendering on OLED.


#include <BluetoothSerial.h>
#include <Wire.h>
#include <Adafruit_GFX.h>
#include <Adafruit_SSD1306.h>

// ------------------------------------------------------------------------------
// Inicializacion de Bluetooth y Pantalla OLED / Bluetooth & OLED Configuration
// ------------------------------------------------------------------------------
BluetoothSerial SerialBT;
const char* BTnombre = "ESP32_Bluetooth"; // [ES] Nombre del dispositivo BT / [EN] BT broadcast name

#define OLED_WIDTH 128
#define OLED_HEIGHT 64
#define OLED_ADDR 0x3C
Adafruit_SSD1306 display(OLED_WIDTH, OLED_HEIGHT, &Wire, -1);
#include <Fonts/FreeMono12pt7b.h>
#include <Fonts/FreeMono24pt7b.h>
#include <Fonts/FreeSans12pt7b.h>
#include <Fonts/FreeSans24pt7b.h>
#include <Fonts/FreeSansBold12pt7b.h >
#include <Fonts/FreeSansBold24pt7b.h >
#include <Fonts/FreeSerif12pt7b.h>
#include <Fonts/FreeSerif24pt7b.h>
const unsigned char PROGMEM LogoITS [] = {
  0xff, 0xff, 0xff, 0xff, 0xff, 0xff, 0xff, 0xff, 0xff, 0xff, 0xff, 0xff, 0xff, 0xff, 0xff, 0xff,
  0xff, 0xff, 0xff, 0xff, 0xff, 0xff, 0xff, 0xc0, 0x07, 0xff, 0xff, 0xff, 0xff, 0xff, 0xff, 0xff,
  0xff, 0xff, 0xff, 0xff, 0xff, 0xff, 0xf8, 0x00, 0x00, 0x7f, 0xff, 0xff, 0xff, 0xff, 0xff, 0xff,
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  0xff, 0xff, 0x08, 0x00, 0x00, 0x00, 0x00, 0x00, 0x00, 0x01, 0xff, 0xff, 0xff, 0xff, 0xff, 0xff
};
const unsigned char Tec_ITS [] PROGMEM = {
 0xff, 0xff, 0xff, 0xff, 0xff, 0xff, 0xcf, 0xff, 0xff, 0xff, 0xff, 0xff, 0xff, 0xff, 0xff, 0xff, 
 0xff, 0xff, 0xff, 0xff, 0xff, 0xff, 0xb7, 0xf0, 0x00, 0x07, 0xe1, 0xff, 0xff, 0xff, 0xff, 0xff, 
  0xff, 0xff, 0xff, 0xff, 0xff, 0xff, 0xbb, 0xc0, 0xff, 0x83, 0xce, 0xff, 0xff, 0xff, 0xff, 0xff, 
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  0xff, 0xff, 0xff, 0xff, 0xff, 0xff, 0xff, 0xff, 0xff, 0xff, 0xff, 0xff, 0xff, 0xff, 0xff, 0xff
};


const unsigned char PROGMEM LOGO[] = {
 0x00, 0x00, 0x00, 0x00, 0x00, 0x00, 0x08, 0x00, 0x00, 0x00, 0x00, 0x00, 0x00, 0x00, 0x00, 0x00,
0x00, 0x00, 0x00, 0x00, 0x00, 0x00, 0x36, 0x00, 0x10, 0x00, 0x00, 0x00, 0x00, 0x00, 0x00, 0x00,
0x00, 0x00, 0x00, 0x00, 0x00, 0x00, 0x1F, 0x00, 0x0C, 0x02, 0x00, 0x00, 0x00, 0x00, 0x00, 0x00,
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0x00, 0x00, 0x00, 0x00, 0x00, 0x00, 0x18, 0x00, 0x1C, 0x00, 0x00, 0x00, 0x00, 0x00, 0x00, 0x00

};















// ------------------------------------------------------------------------------
// Definicion de Pines y Estados / Pin Definitions & LED States
// ------------------------------------------------------------------------------
// Entradas[0]: LED de Estado BT (GPIO 12)
// Entradas[1]: LED Rojo (GPIO 13)
// Entradas[2]: LED Azul (GPIO 14)
// Entradas[3]: LED Amarillo (GPIO 27)
// Entradas[4]: LED Verde (GPIO 26)
const int Entradas[] = {12, 13, 14, 27, 26};
const int numEntradas = sizeof(Entradas) / sizeof(Entradas[0]);

// Banderas de estado de los 4 LEDs / 4-LED boolean state flags
bool estadosLED[4] = {false, false, false, false};

// ------------------------------------------------------------------------------
// Configuracion Inicial / System Setup
// ------------------------------------------------------------------------------
void setup() {
  display.begin(SSD1306_SWITCHCAPVCC, 0x3C); 
  display.display(); 
  delay(2000); 
  display.clearDisplay();
  display.display();
  delay(1000);

  // Presentacion institucional / Splash screens
  display.drawBitmap(0, 0, LogoITS, 128, 64, 1);
  display.display();
  delay(1000);
  display.clearDisplay();
  display.display();
  delay(1000);

  display.drawBitmap(0, 0, Tec_ITS, 128, 64, WHITE);
  display.display();
  delay(1000);
  display.clearDisplay();

display.drawBitmap(0, 0, LOGO, 128, 64, 1);
  display.display();
  delay(1000);
  display.clearDisplay();
  display.display();
  delay(1000);
  
  delay(2000);
  display.clearDisplay(); // Portada / Cover info
  display.setTextSize(1);
  display.setTextColor(WHITE);
  display.setCursor(0, 10);
  display.println("MICROCONTROLADORES");
display.println("P10-Control Bluetooth");
display.display(); 
  delay(2000);
  display.clearDisplay();

  // Configurar pines como salida e iniciar en bajo / Setup pins as outputs (init LOW)
  for (int i = 0; i < numEntradas; i++) {
    pinMode(Entradas[i], OUTPUT);
    digitalWrite(Entradas[i], LOW);
  }

  // Inicializar comunicacion serie y Bluetooth / Init Serial & Bluetooth
  Serial.begin(9600);
  SerialBT.begin(BTnombre);

  // Inicializar pantalla OLED / Init OLED display
  if (!display.begin(SSD1306_SWITCHCAPVCC, 0x3C)) {
    Serial.println("No se pudo inicializar la pantalla OLED / OLED init failed");
    while (true);
  }
  display.clearDisplay();
  display.display();
  actualizarOLED(); // Dibujar los indicadores iniciales / Draw initial indicators
}

// ------------------------------------------------------------------------------
// Decodificador de Comandos Bluetooth / Bluetooth Command Decoder
// ------------------------------------------------------------------------------
void manejarComando(char comando) {
  switch (comando) {
    case 'r': // [ES] Rojo ON     / [EN] Red ON
      digitalWrite(Entradas[1], HIGH); 
      estadosLED[0] = true; 
      break;
    case 'o': // [ES] Rojo OFF    / [EN] Red OFF
      digitalWrite(Entradas[1], LOW); 
      estadosLED[0] = false; 
      break;
    case 'a': // [ES] Azul ON     / [EN] Blue ON
      digitalWrite(Entradas[2], HIGH); 
      estadosLED[1] = true; 
      break;
    case 'z': // [ES] Azul OFF    / [EN] Blue OFF
      digitalWrite(Entradas[2], LOW); 
      estadosLED[1] = false; 
      break;
    case 'm': // [ES] Amarillo ON / [EN] Yellow ON
      digitalWrite(Entradas[3], HIGH); 
      estadosLED[2] = true; 
      break;
    case 'i': // [ES] Amarillo OFF/ [EN] Yellow OFF
      digitalWrite(Entradas[3], LOW); 
      estadosLED[2] = false; 
      break;
    case 'e': // [ES] Verde ON    / [EN] Green ON
      digitalWrite(Entradas[4], HIGH); 
      estadosLED[3] = true; 
      break;
    case 'v': // [ES] Verde OFF   / [EN] Green OFF
      digitalWrite(Entradas[4], LOW); 
      estadosLED[3] = false; 
      break;
    default:
      Serial.println("Comando no reconocido / Unknown command");
      break;
  }
  actualizarOLED(); // Actualizar panel OLED / Update OLED indicators
}

// ------------------------------------------------------------------------------
// Renderizado de Estado en Pantalla OLED / OLED State Rendering
// ------------------------------------------------------------------------------
void actualizarOLED() {
  display.clearDisplay();

  // [ES] Dibujar 4 circulos para representar los LEDs
  // [EN] Draw 4 circles representing physical LED states
  for (int i = 0; i < 4; i++) {
    int x = 20 + i * 25; // Posicion X / X position
    int y = 32;          // Posicion Y / Y position
    if (estadosLED[i]) {
      display.fillCircle(x, y, 10, SSD1306_WHITE); // Encendido: solido / ON: solid circle
    } else {
      display.drawCircle(x, y, 10, SSD1306_WHITE); // Apagado: contorno  / OFF: outline
    }
  }

  display.display();
}

// ------------------------------------------------------------------------------
// Bucle Principal / Main Loop (Recepcion Inalambrica)
// ------------------------------------------------------------------------------
void loop() {
  // [ES] Verificar recepcion de datos via Bluetooth Serial
  // [EN] Check incoming data over Bluetooth Serial
  if (SerialBT.available()) {
    char dato = SerialBT.read();

    // Indicador de actividad / Activity LED indicator
    digitalWrite(Entradas[0], HIGH);

    Serial.println(dato);
    manejarComando(dato);
  }

  delay(500);
}
