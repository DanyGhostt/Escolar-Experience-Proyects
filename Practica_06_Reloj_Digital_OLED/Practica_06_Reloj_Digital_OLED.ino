// ==============================================================================
// Practica 06: Reloj Digital con Interrupciones y Pantalla OLED
// Practice 06: Digital Clock with Hardware Interrupts and OLED Display
//
// Descripcion / Description:
// [ES] Reloj digital en formato HH:MM:SS con base de tiempo incrementada por
//      pulsos externos mediante interrupciones en GPIO 12 y visualizacion grafica
//      en pantalla OLED SSD1306.
// [EN] Digital clock in HH:MM:SS format with time base driven by external hardware
//      interrupt pulses on GPIO 12 and graphical alarm clock rendering on OLED.
//
// ==============================================================================

#include <SPI.h>
#include <Wire.h>
#include <Adafruit_GFX.h>
#include <Adafruit_SSD1306.h>
#include <Fonts/FreeMono12pt7b.h>
#include <Fonts/FreeMono24pt7b.h>
#include <Fonts/FreeSans12pt7b.h>
#include <Fonts/FreeSans24pt7b.h>
#include <Fonts/FreeSansBold12pt7b.h >
#include <Fonts/FreeSansBold24pt7b.h >
#include <Fonts/FreeSerif12pt7b.h>
#include <Fonts/FreeSerif24pt7b.h>
const unsigned char PROGMEM LogoITS [] = {
  0xff, 0xff, 0xff, 0xff, 0xff, 0xff, 0xff, 0xff, 0xff, 0xff, 0xff, 0xff, 0xff, 0xff, 0xff, 0xff,
  0xff, 0xff, 0xff, 0xff, 0xff, 0xff, 0xff, 0xc0, 0x07, 0xff, 0xff, 0xff, 0xff, 0xff, 0xff, 0xff,
  0xff, 0xff, 0xff, 0xff, 0xff, 0xff, 0xf8, 0x00, 0x00, 0x7f, 0xff, 0xff, 0xff, 0xff, 0xff, 0xff,
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  0xff, 0xff, 0x08, 0x00, 0x00, 0x00, 0x00, 0x00, 0x00, 0x01, 0xff, 0xff, 0xff, 0xff, 0xff, 0xff
};
const unsigned char Tec_ITS [] PROGMEM = {
 0xff, 0xff, 0xff, 0xff, 0xff, 0xff, 0xcf, 0xff, 0xff, 0xff, 0xff, 0xff, 0xff, 0xff, 0xff, 0xff, 
 0xff, 0xff, 0xff, 0xff, 0xff, 0xff, 0xb7, 0xf0, 0x00, 0x07, 0xe1, 0xff, 0xff, 0xff, 0xff, 0xff, 
  0xff, 0xff, 0xff, 0xff, 0xff, 0xff, 0xbb, 0xc0, 0xff, 0x83, 0xce, 0xff, 0xff, 0xff, 0xff, 0xff, 
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  0xff, 0xff, 0xff, 0xff, 0xff, 0xff, 0xff, 0xff, 0xff, 0xff, 0xff, 0xff, 0xff, 0xff, 0xff, 0xff
};


const unsigned char PROGMEM LOGO[] = {
 0x00, 0x00, 0x00, 0x00, 0x00, 0x00, 0x08, 0x00, 0x00, 0x00, 0x00, 0x00, 0x00, 0x00, 0x00, 0x00,
0x00, 0x00, 0x00, 0x00, 0x00, 0x00, 0x36, 0x00, 0x10, 0x00, 0x00, 0x00, 0x00, 0x00, 0x00, 0x00,
0x00, 0x00, 0x00, 0x00, 0x00, 0x00, 0x1F, 0x00, 0x0C, 0x02, 0x00, 0x00, 0x00, 0x00, 0x00, 0x00,
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0x00, 0x00, 0x00, 0x00, 0x00, 0x00, 0x18, 0x00, 0x1C, 0x00, 0x00, 0x00, 0x00, 0x00, 0x00, 0x00

};
// ------------------------------------------------------------------------------
// Variables Globales y Definicion de Pantalla / Global Variables & Display
// ------------------------------------------------------------------------------
Adafruit_SSD1306 display(128, 64, &Wire, -1); // ESP32 OLED Display

volatile int pulsos = 0; // [ES] Contador de pulsos de interrupcion / [EN] Interrupt pulse counter
int lectura         = 0;
int Horas           = 10; // [ES] Horas   / [EN] Hours
int Minutos         = 59; // [ES] Minutos / [EN] Minutes
int segundos        = 58; // [ES] Segundos/ [EN] Seconds

// Rutina de interrupcion para conteo de pulsos / Pulse ISR
void INCREMENTO() {
  pulsos++;
}

// ------------------------------------------------------------------------------
// Configuracion Inicial / System Setup
// ------------------------------------------------------------------------------
void setup() {
  pinMode(12, INPUT_PULLUP); // Pin de pulsos de reloj / Clock pulse input pin
  pinMode(2 , OUTPUT);
  display.begin(SSD1306_SWITCHCAPVCC, 0x3C);
  display.clearDisplay();
  display.display();
  delay(500);
  display.clearDisplay();

  // Presentacion institucional / Presentation splash screens
  display.drawBitmap(0, 0, LogoITS, 128, 64, 1);
  display.display();
  delay(1000);
  display.clearDisplay();
  display.display();
  delay(1000);

  display.drawBitmap(0, 0, Tec_ITS, 128, 64, WHITE);
  display.display();
  delay(1000);
  display.clearDisplay();

display.drawBitmap(0, 0, LOGO, 128, 64, 1);
  display.display();
  delay(1000);
  display.clearDisplay();
  display.display();
  delay(1000);
  
  delay(2000);
  display.clearDisplay(); // Portada / Cover info
  display.setTextSize(1);
  display.setTextColor(WHITE);
  display.setCursor(0, 10);
  display.println("MICROCONTROLADORES");
display.println("P6-Reloj Digital");
display.display(); 
  delay(2000);
  display.clearDisplay();  
  
  // Asociar interrupcion en pin 12 por flanco de bajada / Attach falling edge interrupt on pin 12
  attachInterrupt(digitalPinToInterrupt(12), INCREMENTO, FALLING);
  Serial.begin(9600);
}

// ------------------------------------------------------------------------------
// Bucle Principal / Main Loop (Time Keeping Logic)
// ------------------------------------------------------------------------------
void loop() {
  // 120 pulsos equivalen a 1 segundo / 120 pulses equal 1 second
  if (pulsos >= 120) {
    Parpadea(10);
    segundos++;
    pulsos = 0;
    if (segundos == 60) {
      Minutos++;
      segundos = 0;
      if (Minutos == 60) {
        Horas++;
        Minutos = 0;
      }
    }
  }
  Mostrar(segundos, Minutos, Horas);
}

// ------------------------------------------------------------------------------
// Renderizado Grafico del Reloj / Graphical Clock Rendering
// ------------------------------------------------------------------------------
void Mostrar(int Segundos, int Minutos, int Horas) {
  display.clearDisplay();
  
  // [ES] Dibujo de marco de reloj despertador / [EN] Alarm clock frame drawing
  display.drawRoundRect(20, 10, 88, 44, 10, WHITE);  // Cuerpo rectangular / Main body
  display.drawRect(32, 5, 8, 5, WHITE);              // Boton campana izq / Left bell button
  display.drawRect(88, 5, 8, 5, WHITE);              // Boton campana der / Right bell button
  display.drawCircle(25, 55, 5, WHITE);              // Soporte izq / Left foot
  display.drawCircle(103, 55, 5, WHITE);             // Soporte der / Right foot
  
  display.setTextSize(1);
  display.setTextColor(WHITE);
  int textY = 25;

  // [ES] Mostrar Horas / [EN] Display Hours
  int textX = 40;
  display.setCursor(textX, textY);
  if (Horas < 10) display.print("0");
  display.print(Horas);

  display.print(":");

  // [ES] Mostrar Minutos / [EN] Display Minutes
  int minX = 65;
  display.setCursor(minX, textY);  
  if (Minutos < 10) display.print("0");
  display.print(Minutos);

  display.print(":");

  // [ES] Mostrar Segundos / [EN] Display Seconds
  int secX = 90;
  display.setCursor(secX, textY);  
  if (Segundos < 10) display.print("0");
  display.print(Segundos);
  
  display.display();
  delay(1000);
}

// ------------------------------------------------------------------------------
// Animacion de Parpadeo / Blink Animation
// ------------------------------------------------------------------------------
void Parpadea(int input) {
  display.fillRect(43, 43, 4, 4, WHITE);
  display.fillRect(43, 55, 4, 4, WHITE);
  display.fillRect(84, 43, 4, 4, WHITE);
  display.fillRect(84, 55, 4, 4, WHITE);
  display.display();
  delay(input);
  display.drawRect(43, 43, 4, 4, WHITE);
  display.drawRect(43, 55, 4, 4, WHITE);
  display.drawRect(84, 43, 4, 4, WHITE);
  display.drawRect(84, 55, 4, 4, WHITE);
  display.display();
  delay(input);
}
