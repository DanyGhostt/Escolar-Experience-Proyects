// ==============================================================================
// Practica 03: Maquina de Estados Finitos (FSM) con LEDs y Pantalla OLED
// Practice 03: Finite State Machine (FSM) with LEDs and OLED Display
//
// Descripcion / Description:
// [ES] Control de una maquina de estados finitos circular (S1 a S5) con botones
//      de avance/retroceso, 8 salidas digitales a LEDs y representacion en OLED.
// [EN] Circular Finite State Machine (S1 to S5) controller with forward/backward
//      push buttons, 8 digital LED outputs, and graphical state ring on OLED.
// ==============================================================================

#include <Adafruit_GFX.h>
#include <Adafruit_SSD1306.h>
#include <Wire.h>

// ------------------------------------------------------------------------------
// Configuracion de Pantalla OLED / OLED Display Configuration
// ------------------------------------------------------------------------------
#define SCREEN_WIDTH 128
#define SCREEN_HEIGHT 64
Adafruit_SSD1306 display(SCREEN_WIDTH, SCREEN_HEIGHT, &Wire, -1);
#include <Fonts/FreeMono12pt7b.h>
#include <Fonts/FreeMono24pt7b.h>
#include <Fonts/FreeSans12pt7b.h>
#include <Fonts/FreeSans24pt7b.h>
#include <Fonts/FreeSansBold12pt7b.h >
#include <Fonts/FreeSansBold24pt7b.h >
#include <Fonts/FreeSerif12pt7b.h>
#include <Fonts/FreeSerif24pt7b.h>
const unsigned char PROGMEM LogoITS [] = {
  0xff, 0xff, 0xff, 0xff, 0xff, 0xff, 0xff, 0xff, 0xff, 0xff, 0xff, 0xff, 0xff, 0xff, 0xff, 0xff,
  0xff, 0xff, 0xff, 0xff, 0xff, 0xff, 0xff, 0xc0, 0x07, 0xff, 0xff, 0xff, 0xff, 0xff, 0xff, 0xff,
  0xff, 0xff, 0xff, 0xff, 0xff, 0xff, 0xf8, 0x00, 0x00, 0x7f, 0xff, 0xff, 0xff, 0xff, 0xff, 0xff,
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  0xff, 0xff, 0x08, 0x00, 0x00, 0x00, 0x00, 0x00, 0x00, 0x01, 0xff, 0xff, 0xff, 0xff, 0xff, 0xff
};


const unsigned char PROGMEM LOGO[] = {
 0x00, 0x00, 0x00, 0x00, 0x00, 0x00, 0x08, 0x00, 0x00, 0x00, 0x00, 0x00, 0x00, 0x00, 0x00, 0x00,
0x00, 0x00, 0x00, 0x00, 0x00, 0x00, 0x36, 0x00, 0x10, 0x00, 0x00, 0x00, 0x00, 0x00, 0x00, 0x00,
0x00, 0x00, 0x00, 0x00, 0x00, 0x00, 0x1F, 0x00, 0x0C, 0x02, 0x00, 0x00, 0x00, 0x00, 0x00, 0x00,
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0x00, 0x00, 0x00, 0x00, 0x00, 0x00, 0x18, 0x00, 0x1C, 0x00, 0x00, 0x00, 0x00, 0x00, 0x00, 0x00

};
// ------------------------------------------------------------------------------
// Definicion de Pines y Variables / Pin Definitions & State Variables
// ------------------------------------------------------------------------------
// Botones de control / Control push buttons
const int buttonB1 = 15; // [ES] Boton avanzar (GPIO 15)  / [EN] Forward button (GPIO 15)
const int buttonB2 = 4;  // [ES] Boton retroceder (GPIO 4)/ [EN] Backward button (GPIO 4)

// Pines de salida para LEDs / LED Output Pins
const int leds[] = {13, 12, 14, 27, 26, 25, 33, 32};

// Estados de la maquina / FSM State Definitions
enum Estado { S1, S2, S3, S4, S5 };
Estado estadoActual = S1;

// Variables para debouncing de botones / Button debounce reading variables
bool estadoAnteriorB1 = HIGH;
bool estadoAnteriorB2 = HIGH;

// Tabla de verdad: Salidas de cada estado en binario (8 bits)
// Truth table: Output bitmask for each state (8 bits)
const byte salidasEstados[5] = {
  0b00000000, // S1: Todos apagados / All off
  0b11000000, // S2: LEDs 7, 8 ON
  0b00110000, // S3: LEDs 5, 6 ON
  0b00001100, // S4: LEDs 3, 4 ON
  0b00000011  // S5: LEDs 1, 2 ON
};

// ------------------------------------------------------------------------------
// Configuracion Inicial / System Setup
// ------------------------------------------------------------------------------
void setup() {
  display.begin(SSD1306_SWITCHCAPVCC, 0x3C); 
  display.display(); 
  delay(2000); 
  display.clearDisplay();
  display.display();
  delay(1000);

  // Presentacion institucional / Splash screens
  display.drawBitmap(0, 0, LogoITS, 128, 64, 1);
  display.display();
  delay(1000);
  display.clearDisplay();
  display.display();
  delay(1000);

display.drawBitmap(0, 0, LOGO, 128, 64, 1);
  display.display();
  delay(1000);
  display.clearDisplay();
  display.display();
  delay(1000);

  delay(2000);
  display.clearDisplay(); // Portada / Cover info
  display.setTextSize(1);
  display.setTextColor(WHITE);
  display.setCursor(0, 10);
  display.println("MICROCONTROLADORES");
display.println("P3-Maquina Estados");
display.display(); 
  delay(2000);
  display.clearDisplay();

  // Iniciar bus I2C y pantalla OLED / Initialize I2C and OLED display
  Wire.begin();
  if (!display.begin(SSD1306_SWITCHCAPVCC, 0x3C)) {
    while (true);
  }
  display.clearDisplay();
  display.display();

  // Configurar botones con resistencia pullup interna / Configure buttons with internal pullups
  pinMode(buttonB1, INPUT_PULLUP);
  pinMode(buttonB2, INPUT_PULLUP);

  // Configurar pines de LEDs como salidas / Configure LED pins as outputs
  for (int i = 0; i < 8; i++) {
    pinMode(leds[i], OUTPUT);
  }

  // Mostrar el estado inicial / Render initial state
  actualizarPantalla();
  actualizarSalidas();
}

// ------------------------------------------------------------------------------
// Bucle Principal / Main Loop
// ------------------------------------------------------------------------------
void loop() {
  // Lectura de botones / Read button inputs
  bool lecturaB1 = digitalRead(buttonB1);
  bool lecturaB2 = digitalRead(buttonB2);

  // [ES] Avanzar estado con Boton 1 / [EN] Advance state with Button 1
  if (lecturaB1 == LOW && estadoAnteriorB1 == HIGH) {
    avanzarEstado();
    actualizarPantalla();
    actualizarSalidas();
  }
  estadoAnteriorB1 = lecturaB1;

  // [ES] Retroceder estado con Boton 2 / [EN] Go back state with Button 2
  if (lecturaB2 == LOW && estadoAnteriorB2 == HIGH) {
    retrocederEstado();
    actualizarPantalla();
    actualizarSalidas();
  }
  estadoAnteriorB2 = lecturaB2;
}

// ------------------------------------------------------------------------------
// Logica de Transicion de Estados / State Transition Logic
// ------------------------------------------------------------------------------
void avanzarEstado() {
  if (estadoActual == S5) {
    estadoActual = S1;
  } else {
    estadoActual = static_cast<Estado>(estadoActual + 1);
  }
}

void retrocederEstado() {
  if (estadoActual == S1) {
    estadoActual = S5;
  } else {
    estadoActual = static_cast<Estado>(estadoActual - 1);
  }
}

// ------------------------------------------------------------------------------
// Dibujado Grafico del Anillo de Estados / Graphical State Ring Rendering
// ------------------------------------------------------------------------------
void actualizarPantalla() {
  display.clearDisplay();
  
  // Coordenadas del centro de la pantalla / Center screen coordinates
  int centerX = SCREEN_WIDTH / 2;
  int centerY = SCREEN_HEIGHT / 2;

  // Distribucion de los 5 circulos en rueda / 5 circles ring distribution
  int circleX[5] = { centerX, centerX + 25, centerX + 25, centerX - 25, centerX - 25 };
  int circleY[5] = { centerY, centerY - 15, centerY + 15, centerY + 15, centerY - 15 };

  for (int i = 0; i < 5; i++) {
    if (i == estadoActual) {
      // Estado activo: Circulo resaltado / Active state: Highlighted circle
      display.drawCircle(circleX[i], circleY[i], 10, SSD1306_WHITE);
      display.setCursor(circleX[i] - 6, circleY[i] - 4);
      display.setTextSize(1);
      display.setTextColor(SSD1306_WHITE);
      display.print("S");
      display.print(i + 1);
    } else {
      // Estado inactivo / Inactive state
      display.drawCircle(circleX[i], circleY[i], 10, SSD1306_WHITE);
      display.setCursor(circleX[i] - 6, circleY[i] - 4);
      display.setTextSize(1);
      display.setTextColor(SSD1306_BLACK, SSD1306_WHITE);
      display.print("S");
      display.print(i + 1);
    }
  }
  
  display.display();
}

// ------------------------------------------------------------------------------
// Actualizacion de Salidas Digitales / Output Bitmask Update
// ------------------------------------------------------------------------------
void actualizarSalidas() {
  byte salida = salidasEstados[estadoActual];
  for (int i = 0; i < 8; i++) {
    digitalWrite(leds[i], (salida >> i) & 0x01);
  }
}
