// ==============================================================================
// Practica 12: Servidor Web ESP32 para Control de LEDs y Pantalla OLED
// Practice 12: ESP32 Web Server for Wireless LED Control with OLED Display
//
// Descripcion / Description:
// [ES] Servidor web HTTP en ESP32 con panel web HTML/CSS para control remoto de 4
//      canales de LEDs, con visualizacion grafica y animacion de estado en pantalla OLED.
// [EN] HTTP web server on ESP32 serving responsive HTML/CSS dashboard for 4-channel
//      wireless LED control, featuring graphical status animation on SSD1306 OLED.
//
// ==============================================================================

#include <WiFi.h>
#include <Wire.h>
#include <Adafruit_GFX.h>
#include <Adafruit_SSD1306.h>

// ------------------------------------------------------------------------------
// Credenciales de Red WiFi y Pantalla OLED / WiFi Credentials & OLED Display
// ------------------------------------------------------------------------------
const char* ssid = "YOUR_WIFI_SSID";
const char* password = "YOUR_WIFI_PASSWORD";
Adafruit_SSD1306 display(128, 64, &Wire, -1);
#include <Fonts/FreeMono12pt7b.h>
#include <Fonts/FreeMono24pt7b.h>
#include <Fonts/FreeSans12pt7b.h>
#include <Fonts/FreeSans24pt7b.h>
#include <Fonts/FreeSansBold12pt7b.h >
#include <Fonts/FreeSansBold24pt7b.h >
#include <Fonts/FreeSerif12pt7b.h>
#include <Fonts/FreeSerif24pt7b.h>
const unsigned char PROGMEM LogoITS [] = {
  0xff, 0xff, 0xff, 0xff, 0xff, 0xff, 0xff, 0xff, 0xff, 0xff, 0xff, 0xff, 0xff, 0xff, 0xff, 0xff,
  0xff, 0xff, 0xff, 0xff, 0xff, 0xff, 0xff, 0xc0, 0x07, 0xff, 0xff, 0xff, 0xff, 0xff, 0xff, 0xff,
  0xff, 0xff, 0xff, 0xff, 0xff, 0xff, 0xf8, 0x00, 0x00, 0x7f, 0xff, 0xff, 0xff, 0xff, 0xff, 0xff,
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  0xff, 0xff, 0x08, 0x00, 0x00, 0x00, 0x00, 0x00, 0x00, 0x01, 0xff, 0xff, 0xff, 0xff, 0xff, 0xff
};
const unsigned char Tec_ITS [] PROGMEM = {
 0xff, 0xff, 0xff, 0xff, 0xff, 0xff, 0xcf, 0xff, 0xff, 0xff, 0xff, 0xff, 0xff, 0xff, 0xff, 0xff, 
 0xff, 0xff, 0xff, 0xff, 0xff, 0xff, 0xb7, 0xf0, 0x00, 0x07, 0xe1, 0xff, 0xff, 0xff, 0xff, 0xff, 
  0xff, 0xff, 0xff, 0xff, 0xff, 0xff, 0xbb, 0xc0, 0xff, 0x83, 0xce, 0xff, 0xff, 0xff, 0xff, 0xff, 
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  0xff, 0xff, 0xff, 0xff, 0xff, 0xff, 0xff, 0xff, 0xff, 0xff, 0xff, 0xff, 0xff, 0xff, 0xff, 0xff
};


const unsigned char PROGMEM LOGO[] = {
 0x00, 0x00, 0x00, 0x00, 0x00, 0x00, 0x08, 0x00, 0x00, 0x00, 0x00, 0x00, 0x00, 0x00, 0x00, 0x00,
0x00, 0x00, 0x00, 0x00, 0x00, 0x00, 0x36, 0x00, 0x10, 0x00, 0x00, 0x00, 0x00, 0x00, 0x00, 0x00,
0x00, 0x00, 0x00, 0x00, 0x00, 0x00, 0x1F, 0x00, 0x0C, 0x02, 0x00, 0x00, 0x00, 0x00, 0x00, 0x00,
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0x00, 0x00, 0x00, 0x00, 0x00, 0x00, 0x18, 0x00, 0x1C, 0x00, 0x00, 0x00, 0x00, 0x00, 0x00, 0x00

};


// ------------------------------------------------------------------------------
// Variables de Estado de Salidas / Output LED State Variables
// ------------------------------------------------------------------------------
String nom = "ESP32-WebServer";
WiFiServer server(80);

char output1State = 'F'; // [ES] Estado LED 1 (T=ON, F=OFF) / [EN] LED 1 State
char output2State = 'F'; // [ES] Estado LED 2 (T=ON, F=OFF) / [EN] LED 2 State
char output3State = 'F'; // [ES] Estado LED 3 (T=ON, F=OFF) / [EN] LED 3 State
char output4State = 'F'; // [ES] Estado LED 4 (T=ON, F=OFF) / [EN] LED 4 State

// Control de tiempo / Timing variables
unsigned long currentTime = millis();
unsigned long previousTime = 0;
const long timeoutTime = 2000;

// ------------------------------------------------------------------------------
// Configuracion Inicial / System Setup
// ------------------------------------------------------------------------------
void setup() {
  display.begin(SSD1306_SWITCHCAPVCC, 0x3C); 
  display.clearDisplay();

  // Presentacion institucional / Splash screens
  display.drawBitmap(0, 0, LogoITS, 128, 64, 1);
  display.display();
  delay(1000);
  display.clearDisplay();
  display.display();
  delay(1000);

  display.drawBitmap(0, 0, Tec_ITS, 128, 64, WHITE);
  display.display();
  delay(1000);
  display.clearDisplay();

display.drawBitmap(0, 0, LOGO, 128, 64, 1);
  display.display();
  delay(1000);
  display.clearDisplay();
  display.display();
  delay(1000);
  
  Serial.begin(9600);

  // Definir pines de salida / Output Pin Configuration
  pinMode(13, OUTPUT); // [ES] LED Rojo       / [EN] Red LED (GPIO 13)
  pinMode(12, OUTPUT); // [ES] LED Verde      / [EN] Green LED (GPIO 12)
  pinMode(14, OUTPUT); // [ES] LED Amarillo   / [EN] Yellow LED (GPIO 14)
  pinMode(27, OUTPUT); // [ES] LED Azul       / [EN] Blue LED (GPIO 27)
  pinMode(26, OUTPUT); // [ES] LED Monitoreo  / [EN] Activity Monitor LED (GPIO 26)

  display.display();
  delay(1000);
  display.clearDisplay();

  display.setTextSize(1);
  display.setTextColor(WHITE);
  display.setCursor(6, 0);
  display.println("-MICROCONTROLADORES-");
  display.setCursor(8, 10);
  display.println("-HUITZILIHUITL-");
  display.drawLine(0, 20, 150, 20, WHITE);
  display.display();
  delay(1000);
  display.clearDisplay();

  display.setCursor(8, 0);
display.setCursor(8, 10);
display.drawLine(0, 20, 150, 20, WHITE);
  display.display();
  delay(1000);
  display.clearDisplay();

  display.setCursor(25, 0);
  display.println("-PRACTICA 12-");
  display.setCursor(25, 10);
  display.println("-WIFI SERVER OLED-");
  display.drawLine(0, 20, 150, 20, WHITE);
  display.display();
  delay(500);
  display.clearDisplay();
  display.display();

  // Conexion WiFi / WiFi Connection
  Serial.println();
  Serial.println("CONECTANDO A / CONNECTING TO: ");
  Serial.println(ssid);
  WiFi.begin(ssid, password);
  while (WiFi.status() != WL_CONNECTED) {
    delay(500);
    Serial.print(".");
  }
  Serial.println("");
  Serial.println("WiFi CONECTADO / CONNECTED.");
  Serial.println("DIRECCION IP LOCAL / LOCAL IP: ");
  Serial.println(WiFi.localIP());

  // Iniciar servidor web / Start Web Server
  server.begin(); 
}

void loop() {
  //digitalWrite(26,HIGH);
  WiFiClient client = server.available(); // Escuchar clientes entrantes
  if (client) {
    currentTime = millis();
    previousTime = currentTime;
    Serial.println("NUEVO CLIENTE:");
    

    String header = ""; // Variable para almacenar la solicitud del cliente
    String currentLine = "";

    while (client.connected() && currentTime - previousTime <= timeoutTime) {
      currentTime = millis();

      if (client.available()) {
        char c = client.read(); // Leer el caracter
        Serial.write(c); 
        header += c; // Acumular los caracteres en el encabezado

        if (c == '\n') {  // Fin de una línea
          if (currentLine.length() == 0) {
            // Enviar respuesta HTTP
            client.println("HTTP/1.1 200 OK");
            client.println("Content-type:text/html");
            client.println();

            // Comando para cambiar el estado de los LEDs
            if (header.indexOf("GET /1/on") >= 0) {
              Serial.println("Out 1 on");
              output1State = 'T';
              digitalWrite(13, HIGH);  // Encender LED 1 (LED ROJO)
            } else if (header.indexOf("GET /1/off") >= 0) {
              Serial.println("Out 1 off");
              output1State = 'F';
              digitalWrite(13, LOW); // Apagar LED 1 (LED ROJO)
            } else if (header.indexOf("GET /2/on") >= 0) {
              Serial.println("Out 2 on");
              output2State = 'T';
              digitalWrite(12, HIGH);  // Encender LED 2 (LED VERDE)
               display.display();
            } else if (header.indexOf("GET /2/off") >= 0) {
              Serial.println("Out 2 off");
              output2State = 'F';
              digitalWrite(12, LOW); // Apagar LED 2 (LED VERDE)
            } else if (header.indexOf("GET /3/on") >= 0) {
              Serial.println("Out 3 on");
              output3State = 'T';
              digitalWrite(14, HIGH);  // Encender LED 3 (LED AMARILLO)
               display.display();
            } else if (header.indexOf("GET /3/off") >= 0) {
              Serial.println("Out 3 off");
              output3State = 'F';
              digitalWrite(14, LOW); // Apagar LED 3 (LED AMARILLO)
            } else if (header.indexOf("GET /4/on") >= 0) {
              Serial.println("Out 4 on");
              output4State = 'T';
              digitalWrite(27, HIGH);  // Encender LED 4 (LED AZUL)
            } else if (header.indexOf("GET /4/off") >= 0) {
              Serial.println("Out 4 off");
              output4State = 'F';
              digitalWrite(27, LOW); // Apagar LED 4 (LED AZUL)

         
            }
            switch (output1State){
              case 'T':  
                    display.setTextSize(1);                                    
                    display.setTextColor(WHITE);                               
                    display.setCursor(0, 0);                                   
                    display.println("-LED_VERDE_ON-");   
                    delay(1000); 
                    display.display();
                  Serial.println("LLENO");
              break;
              case 'F':
                    display.clearDisplay();
                    display.setTextSize(1);                                    
                    display.setTextColor(WHITE);                               
                    display.setCursor(0, 12);                                   
                    display.println("-LED_VERDE_OFF-");
                    delay(1000);
                    display.display();
                  Serial.println("VACIO");
              break;  
            } 
            switch (output2State){
              case 'T':  
                    display.setTextSize(1);                                    
                    display.setTextColor(WHITE);                               
                    display.setCursor(0, 20);                                   
                    display.println("-LED_AZUL_ON-");   
                    delay(1000); 
                    display.display();
                  Serial.println("LLENO");
              break;
              case 'F':
                    display.clearDisplay();
                    display.setTextSize(1);                                    
                    display.setTextColor(WHITE);                               
                    display.setCursor(0, 28);                                   
                    display.println("-LED_AZUL_OFF-");   
                    delay(1000); 
                    display.display();
                  Serial.println("VACIO");
              break;  
            }
            switch (output3State){
              case 'T':  
                    display.setTextSize(1);                                    
                    display.setTextColor(WHITE);                               
                    display.setCursor(0, 35 );                                 
                    display.println("-LED_ROJO_ON-");   
                    delay(1000); 
                    display.display();
                   Serial.println("LLENO");
              break;
              case 'F':
                    display.clearDisplay();
                    display.setTextSize(1);                                    
                    display.setTextColor(WHITE);                               
                    display.setCursor(0, 42);                                 
                    display.println("-LED_ROJO_OFF-");   
                    delay(1000); 
                    display.display();
                   Serial.println("VACIO");
              break;   
            }
            switch (output4State){
              case 'T': 
                    display.clearDisplay(); 
                    display.setTextSize(1);                                    
                    display.setTextColor(WHITE);                               
                    display.setCursor(0, 45);                                   
                    display.println("-LED_AMARILLO_ON-");   
                    delay(1000); 
                    display.display();
                   Serial.println("LLENO");
              break;
              case 'F':
                    display.clearDisplay();
                    display.setTextSize(1);                                    
                    display.setTextColor(WHITE);                               
                    display.setCursor(0, 54);                                   
                    display.println("-LED_AMARILO_OFF-");   
                    delay(1000); 
                    display.display();
                   Serial.println("VACIO");
              break;                     
            }
            // Código HTML para la interfaz de usuario
            client.println("<!DOCTYPE html>");
            client.println("<html lang=\"en\">");
            client.println("<head>");
            client.println("    <meta charset=\"UTF-8\">");
            client.println("    <meta name=\"viewport\" content=\"width=device-width, initial-scale=1.0\">");
            client.println("    <title>Control de LEDs</title>");
            client.println("    <style>");
            client.println("        body {");
            client.println("            margin: 0;");
            client.println("            padding: 0;");
            client.println("            height: 100vh;");
            client.println("            background: url('https://viveloensaltillo.com/wp-content/uploads/2018/08/1254x851tecsaltillo1-768x521.jpg') no-repeat center center;");
            client.println("            background-size: cover;");
            client.println("            color: white;");
            client.println("            font-family: Arial, sans-serif;");
            client.println("        }");
            client.println("        .top-left {");
            client.println("            position: absolute;");
            client.println("            top: 10px;");
            client.println("            left: 15px;");
            client.println("            color: maroon;");
            client.println("            font-size: 24px;");
            client.println("            font-weight: bold;");
            client.println("        }");
            client.println("        .department {");
            client.println("            position: absolute;");
            client.println("            top: 12%;");
            client.println("            left: 50%;");
            client.println("            transform: translate(-50%, -50%);");
            client.println("            color: white;");
            client.println("            font-size: 24px;");
            client.println("            font-weight: bold;");
            client.println("            text-transform: uppercase;");
            client.println("        }");
            client.println("        .center-top {");
            client.println("            position: absolute;");
            client.println("            top: 18%;");
            client.println("            left: 50%;");
            client.println("            transform: translate(-50%, -50%);");
            client.println("            color: white;");
            client.println("            font-size: 28px;");
            client.println("            font-weight: bold;");
            client.println("        }");
            client.println("        .below-center-top {");
            client.println("            position: absolute;");
            client.println("            top: 22%;");
            client.println("            left: 50%;");
            client.println("            transform: translate(-50%, -50%);");
            client.println("            color: green;");
            client.println("            font-size: 20px;");
            client.println("            font-weight: bold;");
            client.println("        }");
            client.println("        .bottom-right {");
            client.println("            position: absolute;");
            client.println("            bottom: 10px;");
            client.println("            right: 15px;");
            client.println("            text-align: right;");
            client.println("            color: white;");
            client.println("            font-size: 16px;");
            client.println("        }");
            client.println("        .top-right {");
            client.println("            position: absolute;");
            client.println("            top: 10px;");
            client.println("            right: 15px;");
            client.println("            color: blue;");
            client.println("            font-size: 18px;");
            client.println("            font-weight: bold;");
            client.println("            text-align: right;");
            client.println("        }");
            client.println("        .led-status {");
            client.println("            position: absolute;");
            client.println("            top: 25%;");
            client.println("            left: 50%;");
            client.println("            transform: translate(-50%, -50%);");
            client.println("            color: white;");
            client.println("            font-size: 20px;");
            client.println("            font-weight: bold;");
            client.println("        }");
            client.println("        .led-buttons {");
            client.println("            position: absolute;");
            client.println("            top: 50%;"); /* Mover los botones más abajo */
            client.println("            left: 50%;");
            client.println("            transform: translate(-50%, -50%);");
            client.println("            width: 100%;");
            client.println("            display: flex;");
            client.println("            flex-direction: column;");
            client.println("            align-items: center;");
            client.println("        }");
            client.println("        .led-button {");
            client.println("            padding: 10px 20px;");
            client.println("            font-size: 16px;");
            client.println("            background-color: #9E1B32;"); // Guindo
            client.println("            color: white;");
            client.println("            border: none;");
            client.println("            cursor: pointer;");
            client.println("            border-radius: 5px;");
            client.println("            transition: background-color 0.3s;");
            client.println("            margin: 5px;");
            client.println("        }");
            client.println("        .led-button:hover {");
            client.println("            background-color: darkgray;");
            client.println("        }");
            client.println("        .button-row {");
            client.println("            display: flex;");
            client.println("            justify-content: center;");
            client.println("            margin-bottom: 10px;");
            client.println("        }");
            client.println("    </style>");
            client.println("</head>");
            client.println("<body>");
            client.println("    <div class=\"top-left\">Instituto Tecnologico de Saltillo</div>");
            client.println("    <div class=\"department\">Departamento de Electrónica</div>");
            client.println("    <div class=\"center-top\">Microcontroladores</div>");
            client.println("    <div class=\"below-center-top\">Nombre del Maestro: Ing. Huitzilihuitl Saldaña Mora</div>");
            client.println("    <div class=\"bottom-right\">Microcontroladores - ESP32</div>");
            client.println("    <div class=\"top-right\">Practica 12 usando el esp32 como servidor</div>");
            client.println("    <div class=\"led-status\">LED 1: ' + output1State + ' | LED 2: ' + output2State + ' | LED 3: ' + output3State + ' | LED 4: ' + output4State + '</div>");

            // Botones de los LEDs organizados en filas
            client.println("    <div class=\"led-buttons\">");
            
            // Botones LED 1
            client.println("        <div class=\"button-row\">");
            client.println("            <button class=\"led-button\" onclick=\"location.href='/1/on'\">Encender LED 1</button>");
            client.println("            <button class=\"led-button\" onclick=\"location.href='/1/off'\">Apagar LED 1</button>");
            client.println("        </div>");
            
            // Botones LED 2
            client.println("        <div class=\"button-row\">");
            client.println("            <button class=\"led-button\" onclick=\"location.href='/2/on'\">Encender LED 2</button>");
            client.println("            <button class=\"led-button\" onclick=\"location.href='/2/off'\">Apagar LED 2</button>");
            client.println("        </div>");

            // Botones LED 3
            client.println("        <div class=\"button-row\">");
            client.println("            <button class=\"led-button\" onclick=\"location.href='/3/on'\">Encender LED 3</button>");
            client.println("            <button class=\"led-button\" onclick=\"location.href='/3/off'\">Apagar LED 3</button>");
            client.println("        </div>");

            // Botones LED 4
            client.println("        <div class=\"button-row\">");
            client.println("            <button class=\"led-button\" onclick=\"location.href='/4/on'\">Encender LED 4</button>");
            client.println("            <button class=\"led-button\" onclick=\"location.href='/4/off'\">Apagar LED 4</button>");
            client.println("        </div>");

            client.println("    </div>");
            client.println("</body>");
            client.println("</html>");
            client.println();
            break;
          } else {
            currentLine = "";
          }
        } else if (c != '\r') {
          currentLine += c;
        }
      }
    }

    client.stop();
    Serial.println("Cliente desconectado.");
  }
  
}
