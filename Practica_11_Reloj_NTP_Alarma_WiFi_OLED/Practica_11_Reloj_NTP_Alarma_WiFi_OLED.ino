// ==============================================================================
// Practica 11: Reloj Despertador NTP con WiFi, Alarma y Pantalla OLED
// Practice 11: NTP Internet Alarm Clock with WiFi, Buzzer Melody & OLED
//
// Descripcion / Description:
// [ES] Reloj despertador sincronizado a servidores horarios de Internet via NTP,
//      pantalla OLED SSD1306 con fecha y hora, configuracion de alarma mediante
//      4 pulsadores con interrupciones y reproduccion de melodias con Buzzer.
// [EN] Internet-synchronized alarm clock via NTP (Network Time Protocol) over WiFi,
//      SSD1306 OLED display showing date/time, 4 interrupt-driven push buttons to
//      adjust alarm time, and musical tone melody player using a piezo buzzer.
//
// ==============================================================================

#include <Adafruit_GFX.h>
#include <Adafruit_SSD1306.h>
#include <WiFi.h>
#include "time.h"

// ------------------------------------------------------------------------------
// Configuracion de Pantalla OLED / OLED Display Configuration
// ------------------------------------------------------------------------------
#define SCREEN_WIDTH 128
#define SCREEN_HEIGHT 64
Adafruit_SSD1306 display(SCREEN_WIDTH, SCREEN_HEIGHT, &Wire, -1);
#include <Fonts/FreeMono12pt7b.h>
#include <Fonts/FreeMono24pt7b.h>
#include <Fonts/FreeSans12pt7b.h>
#include <Fonts/FreeSans24pt7b.h>
#include <Fonts/FreeSansBold12pt7b.h >
#include <Fonts/FreeSansBold24pt7b.h >
#include <Fonts/FreeSerif12pt7b.h>
#include <Fonts/FreeSerif24pt7b.h>
const unsigned char PROGMEM LogoITS [] = {
  0xff, 0xff, 0xff, 0xff, 0xff, 0xff, 0xff, 0xff, 0xff, 0xff, 0xff, 0xff, 0xff, 0xff, 0xff, 0xff,
  0xff, 0xff, 0xff, 0xff, 0xff, 0xff, 0xff, 0xc0, 0x07, 0xff, 0xff, 0xff, 0xff, 0xff, 0xff, 0xff,
  0xff, 0xff, 0xff, 0xff, 0xff, 0xff, 0xf8, 0x00, 0x00, 0x7f, 0xff, 0xff, 0xff, 0xff, 0xff, 0xff,
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  0xff, 0xff, 0x08, 0x00, 0x00, 0x00, 0x00, 0x00, 0x00, 0x01, 0xff, 0xff, 0xff, 0xff, 0xff, 0xff
};
const unsigned char Tec_ITS [] PROGMEM = {
 0xff, 0xff, 0xff, 0xff, 0xff, 0xff, 0xcf, 0xff, 0xff, 0xff, 0xff, 0xff, 0xff, 0xff, 0xff, 0xff, 
 0xff, 0xff, 0xff, 0xff, 0xff, 0xff, 0xb7, 0xf0, 0x00, 0x07, 0xe1, 0xff, 0xff, 0xff, 0xff, 0xff, 
  0xff, 0xff, 0xff, 0xff, 0xff, 0xff, 0xbb, 0xc0, 0xff, 0x83, 0xce, 0xff, 0xff, 0xff, 0xff, 0xff, 
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  0xff, 0xff, 0xff, 0xff, 0xff, 0xff, 0xff, 0xff, 0xff, 0xff, 0xff, 0xff, 0xff, 0xff, 0xff, 0xff
};


const unsigned char PROGMEM LOGO[] = {
 0x00, 0x00, 0x00, 0x00, 0x00, 0x00, 0x08, 0x00, 0x00, 0x00, 0x00, 0x00, 0x00, 0x00, 0x00, 0x00,
0x00, 0x00, 0x00, 0x00, 0x00, 0x00, 0x36, 0x00, 0x10, 0x00, 0x00, 0x00, 0x00, 0x00, 0x00, 0x00,
0x00, 0x00, 0x00, 0x00, 0x00, 0x00, 0x1F, 0x00, 0x0C, 0x02, 0x00, 0x00, 0x00, 0x00, 0x00, 0x00,
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0x00, 0x00, 0x00, 0x00, 0x00, 0x00, 0x18, 0x00, 0x1C, 0x00, 0x00, 0x00, 0x00, 0x00, 0x00, 0x00

};

// ------------------------------------------------------------------------------
// Parametros de Red WiFi y Servidor NTP / WiFi & NTP Server Configuration
// ------------------------------------------------------------------------------
const char* ssid = "YOUR_WIFI_SSID";          // [ES] Nombre de red WiFi   / [EN] WiFi SSID
const char* password = "YOUR_WIFI_PASSWORD";       // [ES] Contrasena WiFi      / [EN] WiFi Password
const char* ntpServer = "time.google.com"; // [ES] Servidor horario NTP / [EN] NTP Time Server
const long gmtOffset_sec = -21600;         // [ES] Zona horaria GMT-6   / [EN] Timezone offset in seconds (GMT-6)
const int daylightOffset_sec = 0;          // [ES] Horario de verano (0)/ [EN] Daylight savings offset

// ------------------------------------------------------------------------------
// Definicion de Pines / Pin Definitions
// ------------------------------------------------------------------------------
#define BUTTON_HOUR_UP 33     // [ES] Boton +Horas   / [EN] Hours + Button (GPIO 33)
#define BUTTON_HOUR_DOWN 36   // [ES] Boton -Horas   / [EN] Hours - Button (GPIO 36)
#define BUTTON_MINUTE_UP 34   // [ES] Boton +Minutos / [EN] Minutes + Button (GPIO 34)
#define BUTTON_MINUTE_DOWN 35 // [ES] Boton -Minutos / [EN] Minutes - Button (GPIO 35)
#define BUZZER_PIN 13         // [ES] Pin Buzzer     / [EN] Buzzer Pin (GPIO 13)

// ------------------------------------------------------------------------------
// Frecuencias de Notas Musicales (Hz) / Musical Note Frequencies (Hz)
// ------------------------------------------------------------------------------
#define Do 1911
#define DoS 1803
#define Re 1702
#define ReS 1607
#define Mi 1516
#define Fa 1431
#define FaS 1351
#define Sol 1275
#define SolS 1203
#define La 1136
#define LaS 1072
#define Si 1012
#define Do_2 955

// Partitura de la alarma / Alarm melody array
int melody[] = {La, LaS, La, La, Fa, Sol, La, LaS};
int durations[] = {500, 500, 500, 500, 500, 500, 500, 500};

// Variables para la hora y la alarma / Time & Alarm variables
volatile int alarmHour = 0;
volatile int alarmMinute = 0;
char timeHour[3], timeMinute[3], timeSecond[3];
char timeMonthDay[3], timeMonth[10], timeWeekDay[10];

// Variables de debouncing / Button debounce tracking
unsigned long lastPressHourUp = 0;
unsigned long lastPressHourDown = 0;
unsigned long lastPressMinuteUp = 0;
unsigned long lastPressMinuteDown = 0;
const unsigned long debounceDelay = 200; // 200 ms debounce filter

// ------------------------------------------------------------------------------
// Rutinas de Interrupcion para Ajuste de Alarma / Alarm Adjustment ISRs
// ------------------------------------------------------------------------------
void IRAM_ATTR handleHourUp() {
    if (millis() - lastPressHourUp > debounceDelay) {
        alarmHour = (alarmHour + 1) % 24;
        lastPressHourUp = millis();
    }
}

void IRAM_ATTR handleHourDown() {
    if (millis() - lastPressHourDown > debounceDelay) {
        alarmHour = (alarmHour - 1 + 24) % 24;
        lastPressHourDown = millis();
    }
}

void IRAM_ATTR handleMinuteUp() {
    if (millis() - lastPressMinuteUp > debounceDelay) {
        alarmMinute = (alarmMinute + 1) % 60;
        lastPressMinuteUp = millis();
    }
}

void IRAM_ATTR handleMinuteDown() {
    if (millis() - lastPressMinuteDown > debounceDelay) {
        alarmMinute = (alarmMinute - 1 + 60) % 60;
        lastPressMinuteDown = millis();
    }
}

// ------------------------------------------------------------------------------
// Configuracion Inicial / System Setup
// ------------------------------------------------------------------------------
void setup() {
    display.begin(SSD1306_SWITCHCAPVCC, 0x3C);
    display.clearDisplay();
    display.setTextSize(1);
    display.setTextColor(WHITE);

    // Conectar a red WiFi / Connect to WiFi network
    WiFi.begin(ssid, password);
    display.setCursor(0, 0);
    display.print("Conectando a WiFi / Connecting...");
    display.display();

    while (WiFi.status() != WL_CONNECTED) {
        delay(500);
    }
    
    // Configurar cliente NTP de hora / Configure NTP network time
    configTime(gmtOffset_sec, daylightOffset_sec, ntpServer);
  
    // Presentacion institucional / Presentation splash screens
    display.drawBitmap(0, 0, LogoITS, 128, 64, 1);
    display.display();
    delay(1000);
    display.clearDisplay();
    display.display();
    delay(1000);

    display.drawBitmap(0, 0, Tec_ITS, 128, 64, WHITE);
    display.display();
    delay(1000);
    display.clearDisplay();

display.drawBitmap(0, 0, LOGO, 128, 64, 1);
    display.display();
    delay(1000);
    display.clearDisplay();
    display.display();
    delay(1000);
    
    delay(2000);
    display.clearDisplay(); // Portada / Cover info
    display.setTextSize(1);
    display.setTextColor(WHITE);
    display.setCursor(0, 10);
    display.println("MICROCONTROLADORES");
display.println("P11-Reloj NTP Alarma");
display.display(); 
    delay(2000);
    display.clearDisplay();  
 
    // Configurar botones de ajuste con pullup e interrupciones
    // Configure alarm adjustment buttons with pullup and falling edge ISRs
    pinMode(BUTTON_HOUR_UP, INPUT_PULLUP);
    pinMode(BUTTON_HOUR_DOWN, INPUT_PULLUP);
    pinMode(BUTTON_MINUTE_UP, INPUT_PULLUP);
    pinMode(BUTTON_MINUTE_DOWN, INPUT_PULLUP);
    attachInterrupt(BUTTON_HOUR_UP, handleHourUp, FALLING);
    attachInterrupt(BUTTON_HOUR_DOWN, handleHourDown, FALLING);
    attachInterrupt(BUTTON_MINUTE_UP, handleMinuteUp, FALLING);
    attachInterrupt(BUTTON_MINUTE_DOWN, handleMinuteDown, FALLING);

    // Configurar buzzer / Configure buzzer output
    pinMode(BUZZER_PIN, OUTPUT);
}

// ------------------------------------------------------------------------------
// Bucle Principal / Main Loop
// ------------------------------------------------------------------------------
void loop() {
    display.clearDisplay();
    printLocalTime();
    displayAlarmTime();
    checkAlarm(); // Verificar si coincide la hora de alarma / Check if alarm should trigger
}

// ------------------------------------------------------------------------------
// Visualizacion de Fecha y Hora NTP / NTP Date & Time Display
// ------------------------------------------------------------------------------
void printLocalTime() {
    struct tm timeinfo;
    if (!getLocalTime(&timeinfo)) {
        display.setCursor(0, 0);
        display.print("Error obteniendo hora / Time error");
        display.display();
        return;
    }

    strftime(timeHour, 3, "%H", &timeinfo);
    strftime(timeMinute, 3, "%M", &timeinfo);
    strftime(timeSecond, 3, "%S", &timeinfo);
    strftime(timeMonthDay, 3, "%d", &timeinfo);
    strftime(timeMonth, 10, "%B", &timeinfo);
    strftime(timeWeekDay, 10, "%A", &timeinfo);

    display.setTextSize(2);
    display.setCursor(0, 0);
    display.print(timeHour);
    display.print(":");
    display.print(timeMinute);
    display.print(":");
    display.print(timeSecond);

    display.setTextSize(1);
    display.setCursor(0, 20);
    display.print(timeWeekDay);
    display.print(", ");
    display.print(timeMonthDay);
    display.print(" ");
    display.print(timeMonth);

    display.display();
}

// ------------------------------------------------------------------------------
// Visualizacion de Hora de Alarma Programada / Programmed Alarm Display
// ------------------------------------------------------------------------------
void displayAlarmTime() {
    display.setTextSize(1);
    display.setCursor(0, 40);
    display.print("Alarma / Alarm: ");
    if (alarmHour < 10) display.print('0');
    display.print(alarmHour);
    display.print(":");
    if (alarmMinute < 10) display.print('0');
    display.print(alarmMinute);
    display.display();
}

// ------------------------------------------------------------------------------
// Comprobacion de Disparo de Alarma / Alarm Check Trigger
// ------------------------------------------------------------------------------
void checkAlarm() {
    if (atoi(timeHour) == alarmHour && atoi(timeMinute) == alarmMinute) {
        display.clearDisplay();
        display.setTextSize(2);
        display.setCursor(10, 10);
        display.print("ALARMA!");
        display.display();
        playMelody(); // Tocar melodia con buzzer / Play buzzer melody
    }
}

// ------------------------------------------------------------------------------
// Reproduccion de Melodia en Buzzer / Buzzer Melody Player
// ------------------------------------------------------------------------------
void playMelody() {
    for (int i = 0; i < sizeof(melody) / sizeof(melody[0]); i++) {
        int noteDuration = durations[i];
        tone(BUZZER_PIN, melody[i], noteDuration);
        delay(noteDuration * 1.3); // Pausa entre notas / Inter-note pause
        noTone(BUZZER_PIN);
    }
}
